
#include "lcd1100.h"
char bitaddr;
#pragma romdata const_table 
static const unsigned char rom FontLookup[96][5]={ 
{0x00, 0x00, 0x00, 0x00, 0x00},// (space) 
{0x00, 0x00, 0x5F, 0x00, 0x00},// ! 
{0x00, 0x07, 0x00, 0x07, 0x00},// " 
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{0x08, 0x1C, 0x2A, 0x08, 0x08} // <- 
}; 
#pragma romdata 


// clear LCD
void Lcd_Clear(void){
unsigned int i;
spi(CMD,0x40); // Y = 0
spi(CMD,0xb0);
spi(CMD,0x10); // X = 0
spi(CMD,0x0);
spi(CMD,0xae); // disable display;
for(i=0;i<864;i++)
spi(DATA,0x00);
spi(CMD,0xaf); // enable display;
}

// init LCD
void Lcd_Init(void){
cs = 0;
rst = 0;
Delay100TCYx(100);			// 5mS so says the stop watch(less than 5ms will not work)
rst = 1;
spi(CMD,0x20); // write VOP register
spi(CMD,0x90); 
spi(CMD,0xA4); // all on/normal display
spi(CMD,0x2F); // Power control set(charge pump on/off)
spi(CMD,0x40); // set start row address = 0
spi(CMD,0xb0); // set Y-address = 0
spi(CMD,0x10); // set X-address, upper 3 bits
spi(CMD,0x0);  // set X-address, lower 4 bits
spi(CMD,0xC8); // mirror Y axis (about X axis)
spi(CMD,0xa1); // Invert screen in horizontal axis
spi(CMD,0xac); // set initial row (R0) of the display
spi(CMD,0x07);
//spi(CMD,0xF9); // 
spi(CMD,0xaf); // display ON/OFF

Lcd_Clear(); // clear LCD
spi(CMD,0xa7); // invert display
Delay10KTCYx(100);				// 1/2 Sec delay
spi(CMD,0xa6); // normal display (non inverted)
Delay10KTCYx(100);				// 1 Sec delay
}



void spi(char cd,unsigned char myData)
{
char i;
	cs = 0;
	sclk = 0;
	sda = cd;
	sclk = 1;

for(i=0;i<8;i++){
		sclk = 0;
			if(myData & 0x80)
				sda = 1;
			else
				sda = 0;
		sclk = 1;
		myData <<= 1;
		Delay10TCYx(20);
				}
		cs = 1;
}




void SetX(char x){
	spi(CMD,0x10 | ((x>>4)&0x7));
	spi(CMD,x & 0x0f);
}

void SetY(char y){
	char aux = 0;
	while(y>7){
		y -=8;
		aux ++;
	}
	
	bitaddr = y-1;
	spi(CMD,0xB0 | (aux & 0x0f));
}

void Gotoxy(char x,char y){
		spi(CMD,(0xB0|(y&0x0F)));		 // Y axis initialisation: 0100 yyyy			
		spi(CMD,(0x00|(x&0x0F)));		 // X axis initialisation: 0000 xxxx ( x3 x2 x1 x0)
		spi(CMD,(0x10|((x>>4)&0x07))); // X axis initialisation: 0010 0xxx  ( x6 x5 x4)

}


//x dir >    y dir from last line to ^
void VLine(char x,char y,char on){
	char aux[8];
	char i;

	for(i=0;i<8;i++)
		aux[i] = 0;
		
	i = 7;
	while(y > 9){
		aux[i] = 0xff;
		y -= 8;
		i--;
	}
	
	while(y > 0){
		aux[i] >>= 1;
		aux[i] |= 0x80;
		y --;
	}	
	

	
	for(y=0;y<8;y++){
		spi(CMD,0xB0 | y);
		SetX(x);		
		spi(DATA,aux[y]);
	}	
		
}

// xdir is >       y is always < than y2  can be used for graphs
void Line(unsigned char x,unsigned char y,unsigned char y2,unsigned char on){
	char aux[8];
	char i,o;
	char c=1;
	char index;
	

	
	for(i=0;i<8;i++)
		aux[i] = 0;
		

	index = 0;
	for(i=0;i<64;i++){
		
		if(i >= y && i <= y2){
			aux[index] |= c << o;
		}
		
		o ++;
		if(o == 8){
			o = 0;
			index ++;
		}
	}
			
	
	for(i=0;i<8;i++){
		spi(CMD,0xB0 | i);
		SetX(x);		
		spi(DATA,aux[i]);
	}
	
	
}


		
void print_char(char c){
	int i;

        	for ( i = 0; i < 5; i++ ){
				spi(DATA,FontLookup[c - 32][i] << 1);
        }
			spi(DATA,0x00);

}


void print_message(const rom char * message){	// Write message to LCD (C string type)
spi(CMD,0xae); // disable display;
		while (*message){			// Look for end of string
					print_char(*message++);
					}
	spi(CMD,0xaf); // enable display;
						}

void print_string(char * message){	// Write message to LCD (C string type)
spi(CMD,0xae); // disable display;
		while (*message){			// Look for end of string
					print_char(*message++);
					}
	spi(CMD,0xaf); // enable display;
						}